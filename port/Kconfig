## port/Kconfig
```kconfig
menu "esp-azure"

    config ESP_AZURE_USE_SECURE_ELEMENT
        bool "Enable use secure element for TLS"
        help
            Enable use secure element for TLS, depends on esp-cryptoauthlib

    config DISABLE_AZURE_SDK_LOGGING
        bool "Disable Azure SDK Logging"
        default n
        help
            Disable Azure SDK Logging

endmenu # esp-azure
```
